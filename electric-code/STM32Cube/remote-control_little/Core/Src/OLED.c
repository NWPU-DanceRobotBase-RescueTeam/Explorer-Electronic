#include <stdio.h>
#include "OLED.h"
#include "tim.h"
#include "key.h"

/**
 * @brief  开始界面
 * @param  void
 * @retval void
 */

void Show_Start(void)
{
	HAL_TIM_Base_Stop(&htim5);
	LCD_CLS();
	LCD_P16X16Str(2, 1, (unsigned char*) "小援小援", RED, BLACK);
	LCD_P16X16Str(0, 2, (unsigned char*) "一路火花带闪电！", CYAN, BLACK);
	LCD_P16X16Str(0, 4, (unsigned char*) "开机中", YELLOW, BLACK);
	HAL_Delay(300);
	LCD_P8X16Str(6, 4, (unsigned char*) "..", YELLOW, BLACK);
	HAL_Delay(300);
//	IWDG_Feed();
	LCD_P8X16Str(8, 4, (unsigned char*) "..", YELLOW, BLACK);
	HAL_Delay(300);
	LCD_P8X16Str(10, 4, (unsigned char*) "..", YELLOW, BLACK);
	HAL_Delay(300);
	LCD_P8X16Str(12, 4, (unsigned char*) "..", YELLOW, BLACK);
	HAL_Delay(300);
//	IWDG_Feed();
	LCD_P8X16Str(14, 4, (unsigned char*) "..", YELLOW, BLACK);
	HAL_Delay(300);
	LCD_CLS();   //OLED清屏
	HAL_TIM_Base_Start(&htim5);
}

/**
 * @brief  显示速度
 * @param  void
 * @retval void
 */

void Show_Speed(void)
{
	int8_t iadcxleft, iadcyright;
	char qian[5], hou[5], zuo[5], you[5];
	iadcxleft = (int8_t) adcxleft - 100;
	iadcyright = (int8_t) adcyright - 100;

	if (iadcxleft > 0)
	{
		sprintf(you, "%d ", iadcxleft);
		sprintf(zuo, "%d ", 0);
	}
	else
	{
		sprintf(zuo, "%d ", -iadcxleft);
		sprintf(you, "%d ", 0);
	}
	if (iadcyright > 0)
	{
		sprintf(qian, "%d ", iadcyright);
		sprintf(hou, "%d ", 0);
	}
	else
	{
		sprintf(hou, "%d ", -iadcyright);
		sprintf(qian, "%d ", 0);
	}
	//       LCD_P8X16Str(2,1,"123456789",BLUE,BLACK);         //显示英文8*16字符串
	LCD_P16X16Str(1, 1, (unsigned char*) "前", YELLOW, BLACK);     //显示汉字字符串
	LCD_P8X16Str(4, 1, (unsigned char*) ":", WHITE, BLACK);
	LCD_P16X16Str(4, 1, (unsigned char*) "后", YELLOW, BLACK);
	LCD_P8X16Str(10, 1, (unsigned char*) ":", WHITE, BLACK);
	LCD_P16X16Str(1, 3, (unsigned char*) "左", YELLOW, BLACK);
	LCD_P8X16Str(4, 3, (unsigned char*) ":", WHITE, BLACK);
	LCD_P16X16Str(4, 3, (unsigned char*) "右", YELLOW, BLACK);
	LCD_P8X16Str(10, 3, (unsigned char*) ":", WHITE, BLACK);
	LCD_P16X16Str(2, 4, (unsigned char*) "档位", YELLOW, BLACK);
	LCD_P8X16Str(8, 4, (unsigned char*) ":", WHITE, BLACK);

	LCD_P8X16Str(5, 1, (unsigned char*) qian, WHITE, BLACK);
	LCD_P8X16Str(11, 1, (unsigned char*) hou, WHITE, BLACK);
	LCD_P8X16Str(5, 3, (unsigned char*) zuo, WHITE, BLACK);
	LCD_P8X16Str(11, 3, (unsigned char*) you, WHITE, BLACK);
	if (mode == 0)
		LCD_P16X16Str(5, 4, (unsigned char*) "无", WHITE, BLACK);
	else if (mode == 1)
		LCD_P16X16Str(5, 4, (unsigned char*) "低", YELLOW, BLACK);
	else if (mode == 2)
		LCD_P16X16Str(5, 4, (unsigned char*) "中", ORANGE, BLACK);
	else if (mode == 3)
		LCD_P16X16Str(5, 4, (unsigned char*) "高", RED, BLACK);

}

/**
 * @brief  LCD初始化
 * @param  void
 * @retval void
 */

void LCD_init(void)
{
	HAL_TIM_Base_Stop(&htim5);
	//初始化
	HAL_GPIO_WritePin(LQTFT_A0_GPIO_Port, LQTFT_A0_Pin, GPIO_PIN_SET); //  	LQTFT_A0=1;
	HAL_GPIO_WritePin(LQTFT_SDA_GPIO_Port, LQTFT_SDA_Pin, GPIO_PIN_SET); //   	LQTFT_SDA=1;
	HAL_GPIO_WritePin(LQTFT_SCK_GPIO_Port, LQTFT_SCK_Pin, GPIO_PIN_SET); //  	LQTFT_SCK=1;
	HAL_GPIO_WritePin(LQTFT_CS_GPIO_Port, LQTFT_CS_Pin, GPIO_PIN_SET); //  	LQTFT_CS=1;

	HAL_GPIO_WritePin(LQTFT_RST_GPIO_Port, LQTFT_RST_Pin, GPIO_PIN_RESET); //   LQTFT_RST=0;
	HAL_Delay(200);
	HAL_GPIO_WritePin(LQTFT_RST_GPIO_Port, LQTFT_RST_Pin, GPIO_PIN_SET); //   LQTFT_RST=1;
	HAL_Delay(50);
	LCD_write_command(0x11);     //start OSC
	HAL_Delay(100);

	LCD_write_command(0xB1);     //frame rate control
	LCD_write_para8(0x05);
	LCD_write_para8(0x3A);
	LCD_write_command(0x36);     //镜像控制?
	LCD_write_para8(0x08);  //
	LCD_write_command(0xB2);
	LCD_write_para8(0x05);
	LCD_write_para8(0x3A);
	LCD_write_command(0xB3);
	LCD_write_para8(0x05);
	LCD_write_para8(0x3A);
	LCD_write_para8(0x05);
	LCD_write_para8(0x3A);
	LCD_write_command(0xB4);  //inversion setting
	LCD_write_para8(0x00);  //0x00=dot inversion
	LCD_write_command(0xC0);  //Power Control 1
	LCD_write_para8(0xAA);  //AVDD=5V;GVDD=4.2V
	LCD_write_para8(0x0A);  //GVCL=-4.2V
	LCD_write_para8(0x84);  //Mode=AUTO;VRHP=VRHN=0
	LCD_write_command(0xC1);  //Power Control 2
	LCD_write_para8(0xC0); //V25=2.4V;VGH=2AVDD+VGH25-0.5=11.9V;VGL=-7.5V
	LCD_write_command(0xC2);  //Power Control 3
	LCD_write_para8(0x0D);  //
	LCD_write_para8(0x00);  //
	LCD_write_command(0xC3);  //Power Control 4
	LCD_write_para8(0x8D);  //
	LCD_write_para8(0x2A);  //
	LCD_write_command(0xC4);  //Power Control 5
	LCD_write_para8(0x8D);
	LCD_write_para8(0xEE);
	LCD_write_command(0xC5);  //VCOM setting
	LCD_write_para8(0x06);  //
	LCD_write_command(0xE0);
	LCD_write_para8(0x06);
	LCD_write_para8(0x1C);
	LCD_write_para8(0x10);
	LCD_write_para8(0x14);
	LCD_write_para8(0x30);
	LCD_write_para8(0x2B);
	LCD_write_para8(0x24);
	LCD_write_para8(0x29);
	LCD_write_para8(0x28);
	LCD_write_para8(0x26);
	LCD_write_para8(0x2E);
	LCD_write_para8(0x39);
	LCD_write_para8(0x00);
	LCD_write_para8(0x02);
	LCD_write_para8(0x01);
	LCD_write_para8(0x10);
	LCD_write_command(0xE1);
	LCD_write_para8(0x06);
	LCD_write_para8(0x1C);
	LCD_write_para8(0x10);
	LCD_write_para8(0x14);
	LCD_write_para8(0x30);
	LCD_write_para8(0x2B);
	LCD_write_para8(0x24);
	LCD_write_para8(0x29);
	LCD_write_para8(0x28);
	LCD_write_para8(0x26);
	LCD_write_para8(0x2E);
	LCD_write_para8(0x39);
	LCD_write_para8(0x00);
	LCD_write_para8(0x02);
	LCD_write_para8(0x01);
	LCD_write_para8(0x10);
	LCD_write_command(0x3A);  //
	LCD_write_para8(0x05);  //RGB 16-bit
	LCD_write_command(0x29);  //display on
	HAL_Delay(200);
	LCD_display_full(BLACK);
	HAL_TIM_Base_Start(&htim5);
}

/**********************************************************
 函数名称：LCD_init()
 入口参数：无
 出口参数：无
 时间：2016/11/12
 功能说明：器件初始化
 其他说明：无
 **********************************************************/

/******************DRIVE IC寄存器寻址 8080 SERIES*******************************/
void LCD_write_command(unsigned char cmd)
{
	unsigned char i;

	HAL_GPIO_WritePin(LQTFT_A0_GPIO_Port, LQTFT_A0_Pin, GPIO_PIN_RESET); //  LQTFT_A0=0;	 	//A0=0发送命令
	HAL_GPIO_WritePin(LQTFT_CS_GPIO_Port, LQTFT_CS_Pin, GPIO_PIN_RESET); //  LQTFT_CS=0;
	for (i = 0; i < 8; i++)
	{
		HAL_GPIO_WritePin(LQTFT_SCK_GPIO_Port, LQTFT_SCK_Pin, GPIO_PIN_RESET); //  LQTFT_SCK=0;
		if ((cmd & 0x80) == 0x80)	  	//高位先发送
			HAL_GPIO_WritePin(LQTFT_SDA_GPIO_Port, LQTFT_SDA_Pin, GPIO_PIN_SET);	//  LQTFT_SDA=1;
		else
			HAL_GPIO_WritePin(LQTFT_SDA_GPIO_Port, LQTFT_SDA_Pin, GPIO_PIN_RESET);	//  LQTFT_SDA=0;
		//LQTFT_SDA =((0x80&cmd>0)?1:0);
		HAL_GPIO_WritePin(LQTFT_SCK_GPIO_Port, LQTFT_SCK_Pin, GPIO_PIN_SET);	//  LQTFT_SCK = 1;
		cmd = (cmd << 1);

	}
	HAL_GPIO_WritePin(LQTFT_CS_GPIO_Port, LQTFT_CS_Pin, GPIO_PIN_SET);		//  LQTFT_CS=1;
}

/*****************DRIVE IC寄存器写数据 8080 SERIES******************************/
void LCD_write_para8(unsigned char dat)
{
	unsigned char i;

	HAL_GPIO_WritePin(LQTFT_A0_GPIO_Port, LQTFT_A0_Pin, GPIO_PIN_SET);		//   LQTFT_A0=1;			//A0=1发送数据
	HAL_GPIO_WritePin(LQTFT_CS_GPIO_Port, LQTFT_CS_Pin, GPIO_PIN_RESET);		//   LQTFT_CS=0;
	for (i = 0; i < 8; i++)
	{
		HAL_GPIO_WritePin(LQTFT_SCK_GPIO_Port, LQTFT_SCK_Pin, GPIO_PIN_RESET);		//  LQTFT_SCK=0;
		if ((dat & 0x80) == 0x80)
			HAL_GPIO_WritePin(LQTFT_SDA_GPIO_Port, LQTFT_SDA_Pin, GPIO_PIN_SET);	//  LQTFT_SDA=1;
		else
			HAL_GPIO_WritePin(LQTFT_SDA_GPIO_Port, LQTFT_SDA_Pin, GPIO_PIN_RESET);	//  LQTFT_SDA=0;
		//LQTFT_SDA =((0x80&dat>0)?1:0);
		HAL_GPIO_WritePin(LQTFT_SCK_GPIO_Port, LQTFT_SCK_Pin, GPIO_PIN_SET);	//  LQTFT_SCK = 1;
		dat = (dat << 1);

	}
	HAL_GPIO_WritePin(LQTFT_CS_GPIO_Port, LQTFT_CS_Pin, GPIO_PIN_SET);		//  LQTFT_CS=1;
}

/****************DRIVE IC GDRAM 写数据 16BITS 8080 SERIES*****************************/
void LCD_write_para16(unsigned int dat)
{
	unsigned char i, buf;
	HAL_GPIO_WritePin(LQTFT_A0_GPIO_Port, LQTFT_A0_Pin, GPIO_PIN_SET);		//   LQTFT_A0=1;			//A0=1发送数据
	HAL_GPIO_WritePin(LQTFT_CS_GPIO_Port, LQTFT_CS_Pin, GPIO_PIN_RESET);		//   LQTFT_CS=0;

	buf = (unsigned char) (0xFF & (dat >> 8));
	for (i = 0; i < 8; i++)
	{
		HAL_GPIO_WritePin(LQTFT_SCK_GPIO_Port, LQTFT_SCK_Pin, GPIO_PIN_RESET);		//  LQTFT_SCK=0;
		if ((buf & 0x80) == 0x80)
			HAL_GPIO_WritePin(LQTFT_SDA_GPIO_Port, LQTFT_SDA_Pin, GPIO_PIN_SET);	//  LQTFT_SDA=1;
		else
			HAL_GPIO_WritePin(LQTFT_SDA_GPIO_Port, LQTFT_SDA_Pin, GPIO_PIN_RESET);	//  LQTFT_SDA=0;
		//LQTFT_SDA =((0x80&buf>0)?1:0);
		HAL_GPIO_WritePin(LQTFT_SCK_GPIO_Port, LQTFT_SCK_Pin, GPIO_PIN_SET);	//  LQTFT_SCK = 1;
		buf = (buf << 1);

	}
	HAL_GPIO_WritePin(LQTFT_CS_GPIO_Port, LQTFT_CS_Pin, GPIO_PIN_SET);		//   LQTFT_CS=1;

	buf = (unsigned char) (0xFF & dat);
	HAL_GPIO_WritePin(LQTFT_CS_GPIO_Port, LQTFT_CS_Pin, GPIO_PIN_RESET);		//   LQTFT_CS=0;
	for (i = 0; i < 8; i++)
	{
		HAL_GPIO_WritePin(LQTFT_SCK_GPIO_Port, LQTFT_SCK_Pin, GPIO_PIN_RESET);		//  LQTFT_SCK=0;
		if ((buf & 0x80) == 0x80)
			HAL_GPIO_WritePin(LQTFT_SDA_GPIO_Port, LQTFT_SDA_Pin, GPIO_PIN_SET);	//  LQTFT_SDA=1;
		else
			HAL_GPIO_WritePin(LQTFT_SDA_GPIO_Port, LQTFT_SDA_Pin, GPIO_PIN_RESET);	//  LQTFT_SDA=0;
		//LQTFT_SDA =((0x80&buf>0)?1:0);
		HAL_GPIO_WritePin(LQTFT_SCK_GPIO_Port, LQTFT_SCK_Pin, GPIO_PIN_SET);	//  LQTFT_SCK = 1;
		buf = (buf << 1);
	}
	HAL_GPIO_WritePin(LQTFT_CS_GPIO_Port, LQTFT_CS_Pin, GPIO_PIN_SET);		//  LQTFT_CS=1;
}

/**********************************************************
 函数名称：LCD_SetPos()
 入口参数：起始终止坐标
 出口参数：无
 时间：2016/11/12
 功能说明：重新定位输入信息位置
 其他说明：无
 **********************************************************/
void LCD_SetPos(unsigned char xs, unsigned char ys, unsigned char xe, unsigned char ye)
{
	LCD_write_command(0x2A);      	//Colulm addRSTs set
	LCD_write_para8(0x00);		//行起始坐标高8位，始终为零
	LCD_write_para8(xs);		//行起始坐标低8位
	LCD_write_para8(0x00);		//行终止坐标高8位，始终为零
	LCD_write_para8(xe);		//行终止坐标低8位
	LCD_write_command(0x2B);      	//Colulm addRSTs set
	LCD_write_para8(0x00);		//列起始坐标高8位，始终为零
	LCD_write_para8(ys);		//列起始坐标低8位
	LCD_write_para8(0x00);		//列终止坐标高8位，始终为零
	LCD_write_para8(ye);		//列终止坐标低8位
	LCD_write_command(0x2C);      	//GRAM接收MCU数据或命令
}

/**********************************************************
 函数名称：LCD_address_rst()
 入口参数：无
 出口参数：无
 时间：2016/11/12
 功能说明：重置地址
 其他说明：无
 **********************************************************/
void LCD_address_rst(void)
{
	LCD_write_command(0x2a);            //配置MCU可操作的LCD内部RAM横坐标起始、结束参数
	LCD_write_para8(0x00);		//横坐标起始地址0x0000
	LCD_write_para8(0x00);
	LCD_write_para8(0x00);		//横坐标结束地址0x007f(127)
	LCD_write_para8(0x7f);
	LCD_write_command(0x2b);            //配置MCU可操作的LCD内部RAM纵坐标起始结束参数
	LCD_write_para8(0x00);		//纵坐标起始地址0x0000
	LCD_write_para8(0x30);
	LCD_write_para8(0x00);		//纵坐标结束地址0x009f(159)
	LCD_write_para8(0x70);
	LCD_write_command(0x2C);      	//GRAM接收MCU数据或命令
}

/*********************************************************/
//延时函数
void time_delay(unsigned int t)
{
	unsigned int i, j;

	for (j = 0; j < t; j++)
		for (i = 0; i < 1000; i++);
}

/**********************************************************
 函数名称：LCD_display_full()
 入口参数：color为常用的需要显示的颜色(已经提前定义)，color为
 NULL时，则可将不常用颜色放入dat中加以显示
 出口参数：无
 时间：2012-09-09
 功能说明：全屏显示单色画面
 其他说明：无
 **********************************************************/
void LCD_display_full(unsigned int color)
{
	unsigned int i, j;

	LCD_SetPos(0, 0, XMAX, YMAX+1);
	for (i = 0; i < XMAX; i++)
	{
		for (j = 0; j < YMAX+1; j++)
		{
			LCD_write_para16(color);
		}
	}
}
void LCD_CLS(void)
{
	LCD_display_full(BLACK);
}

/**********************************************************
 函数名称：LCD_draw_part()
 入口参数：起始、终止横坐标(0-127)，纵坐标(0-159),显示颜色word
 出口参数：无
 时间：2012-09-09
 功能说明：填充矩形区域
 其他说明：0<=xs<xe<=127
 0<=ys<ye<=159
 **********************************************************/
void LCD_draw_part(unsigned char xs, unsigned char ys, unsigned char xe, unsigned char ye, unsigned int color_dat)
{
	unsigned char i, j;
//        int k;

	LCD_SetPos(xs, ys, xe, ye);
	for (j = 0; j < (ye - ys + 1); j++)
	{
		for (i = 0; i < (xe - xs + 1); i++)
		{
			LCD_write_para16(color_dat);
			//慢动作设置，时间越长，打点越慢！
			//for(k=0;k<300;k++);
		}
	}
}

/**********************************************************
 函数名称：LCD_draw_rectangle()
 入口参数：起始、终止横坐标(0-127)，纵坐标(0-159),显示颜色word
 出口参数：无
 时间：2012-09-09
 功能说明：画矩形边框
 其他说明：0<=xs<xe<=127
 0<=ys<ye<=159
 **********************************************************/
void LCD_draw_rectangle(unsigned char xs, unsigned char ys, unsigned char xe, unsigned char ye, unsigned int color_dat)
{
	LCD_draw_line(xs, ys, xs, ye, color_dat);	  //画矩形左边
	LCD_draw_line(xe, ys, xe, ye, color_dat);	  //画矩形右边
	LCD_draw_line(xs, ys, xe, ys, color_dat);	  //画矩形上边
	LCD_draw_line(xs, ye, xe, ye, color_dat);	  //画矩形下边
	//     HAL_Delay(1); //慢动作设置，时间越长，打点越慢！
}

/**********************************************************
 函数名称：LCD_draw_circle()
 入口参数：圆心横坐标(0-127)，纵坐标(0-159),半径(0-128),显示颜色word
 出口参数：无
 时间：2012-09-09
 功能说明：画圆形边框(仅支持屏幕内画圆)
 其他说明：0<=x<=127
 0<=y<=159
 **********************************************************/
void LCD_draw_circle(unsigned char x, unsigned char y, unsigned char r, unsigned int color_dat)
{
	unsigned char dx, dy = r;

	if ((x >= r) && ((XMAX - x) >= r) && (y >= r) && ((YMAX - y) >= r))	//确定所画圆在屏幕范围内，没有超出最外边，(暂不支持与屏幕边相交)
	{
		for (dx = 0; dx <= r; dx++)
		{
			while ((r * r + 1 - dx * dx) < (dy * dy))
				dy--;
			LCD_draw_dot(x + dx, y - dy, color_dat);
			LCD_draw_dot(x - dx, y - dy, color_dat);
			LCD_draw_dot(x - dx, y + dy, color_dat);
			LCD_draw_dot(x + dx, y + dy, color_dat);

			LCD_draw_dot(x + dy, y - dx, color_dat);
			LCD_draw_dot(x - dy, y - dx, color_dat);
			LCD_draw_dot(x - dy, y + dx, color_dat);
			LCD_draw_dot(x + dy, y + dx, color_dat);
			//     HAL_Delay(1); //慢动作设置，时间越长，打点越慢！
		}
	}
}

/**********************************************************
 函数名称：LCD_draw_line()
 入口参数：起始、终止横坐标(0-127)，纵坐标(0-159),显示颜色word
 出口参数：无
 时间：2012-09-09
 功能说明：画直线
 其他说明：0<=xs<xe<=127
 0<=ys<ye<=159
 **********************************************************/
void LCD_draw_line(unsigned char xs, unsigned char ys, unsigned char xe, unsigned char ye, unsigned int color_dat)
{
	unsigned char i, ds;
	int dx, dy, inc_x, inc_y;
	int xerr = 0, yerr = 0;				//初始化变量

	if (xs == xe)	  						//如果是画垂直线则只需对竖直坐标计数
	{
		LCD_SetPos(xs, ys, xe, ye);
		for (i = 0; i < (ye - ys + 1); i++)
		{
			LCD_write_para16(color_dat);
			//        HAL_Delay(1); //慢动作设置，时间越长，打点越慢！
		}
	}
	else if (ys == ye)						//如果是水平线则只需要对水平坐标计数
	{
		LCD_SetPos(xs, ys, xe, ye);
		for (i = 0; i < (xe - xs + 1); i++)
		{
			LCD_write_para16(color_dat);
			//        HAL_Delay(1); //慢动作设置，时间越长，打点越慢！
		}
	}
	else											//如果是斜线，则重新计算，使用画点函数画出直线
	{
		dx = xe - xs;								//计算坐标增量
		dy = ye - ys;

		if (dx > 0)
			inc_x = 1;						//设置单步方向
		else
		{
			inc_x = -1;
			dx = -dx;
		}
		if (dy > 0)
			inc_y = 1;						//设置单步方向
		else
		{
			inc_y = -1;
			dy = -dy;
		}

		if (dx > dy)
			ds = dx;						//选取基本增量坐标轴
		else
			ds = dy;

		for (i = 0; i <= ds + 1; i++)					//画线输出
		{
			LCD_draw_dot(xs, ys, color_dat);	//画点
//     delay_ms(1); //慢动作设置，时间越长，打点越慢！
			xerr += dx;
			yerr += dy;
			if (xerr > ds)
			{
				xerr -= ds;
				xs += inc_x;
			}
			if (yerr > ds)
			{
				yerr -= ds;
				ys += inc_y;
			}
		}
	}
}

/**********************************************************
 函数名称：LCD_draw_dot()
 入口参数：起始横坐标(0-127)，纵坐标(0-63),显示颜色word
 出口参数：无
 时间：2012-09-09
 功能说明：画点
 其他说明：0<=x<=127
 0<=y<=63
 **********************************************************/
void LCD_draw_dot(unsigned char x, unsigned char y, unsigned int color_dat)
{
	LCD_SetPos(x, y, x, y);
	LCD_write_para16(color_dat);
}

///****************显示图片（从单片机的DATA区）********************************/
//void display_pic()
//{
//	unsigned int i,j,k=0;

//	LCD_SetPos(2,0,XMAX-3,YMAX-1);
//	for(i=0;i<XMAX;i++)
//	{ 
//	   	for(j=0;j<YMAX;j++)
//		{			
//		  LCD_write_para16(((unsigned int)PIC[k])<<8|PIC[k+1]);			
//		  k+=2; 
//		}
//	}    
// }

//void show_pic(unsigned char xs,unsigned char ys,unsigned char xe,unsigned char ye,unsigned char *ppic)
//{
//	unsigned int i,j,k=0;

//	LCD_SetPos(xs,ys,xe,ye);
//	for(i=0;i<ye-ys;i++)
//	{ 
//	   	for(j=0;j<xe-xs;j++)
//		{			
//		  LCD_write_para16(((unsigned int)ppic[k])<<8|ppic[k+1]);			
//		  k+=2;
//		}
//	}    
// }

///*--------------------------------------------------------------*/
////	  字体:	8*6字体                              //wrong
////取码规则:	低位在前, 列行扫描, 阴码(1-亮, 0-灭)
////查表方法: 要显示的ASCII码-32就可以得到字库码的指针
//unsigned char Font_code8[][6] = {
//{0x00,0x00,0x00,0x00,0x00,0x00},// (0)
//{0x00,0x00,0x00,0x4F,0x00,0x00},//!(1)
//{0x00,0x00,0x07,0x00,0x07,0x00},//"(2)
//{0x00,0x14,0x7F,0x14,0x7F,0x14},//#(3)
//{0x00,0x24,0x2A,0x7F,0x2A,0x12},//$(4)
//{0x00,0x23,0x13,0x08,0x64,0x62},//%(5)
//{0x00,0x36,0x49,0x55,0x22,0x50},//&(6)
//{0x00,0x00,0x05,0x03,0x00,0x00},//'(7)
//{0x00,0x00,0x1C,0x22,0x41,0x00},//((8)
//{0x00,0x00,0x41,0x22,0x1C,0x00},//)(9)
//{0x00,0x14,0x08,0x3E,0x08,0x14},//*(10)
//{0x00,0x08,0x08,0x3E,0x08,0x08},//+(11)
//{0x00,0x00,0x50,0x30,0x00,0x00},//,(12)
//{0x00,0x08,0x08,0x08,0x08,0x08},//-(13)
//{0x00,0x00,0x60,0x60,0x00,0x00},//.(14)
//{0x00,0x20,0x10,0x08,0x04,0x02},///(15)
//{0x00,0x3E,0x51,0x49,0x45,0x3E},//0(16)
//{0x00,0x00,0x42,0x7F,0x40,0x00},//1(17)
//{0x00,0x42,0x61,0x51,0x49,0x46},//2(18)
//{0x00,0x21,0x41,0x45,0x4B,0x31},//3(19)
//{0x00,0x18,0x14,0x12,0x7F,0x10},//4(20)
//{0x00,0x27,0x45,0x45,0x45,0x39},//5(21)
//{0x00,0x3C,0x4A,0x49,0x49,0x30},//6(22)
//{0x00,0x01,0x71,0x09,0x05,0x03},//7(23)
//{0x00,0x36,0x49,0x49,0x49,0x36},//8(24)
//{0x00,0x06,0x49,0x49,0x29,0x1E},//9(25)
//{0x00,0x00,0x36,0x36,0x00,0x00},//:(26)
//{0x00,0x00,0x56,0x36,0x00,0x00},//;(27)
//{0x00,0x08,0x14,0x22,0x41,0x00},//<(28)
//{0x00,0x14,0x14,0x14,0x14,0x14},//=(29)
//{0x00,0x00,0x41,0x22,0x14,0x08},//>(30)
//{0x00,0x02,0x01,0x51,0x09,0x06},//?(31)
//{0x00,0x32,0x49,0x79,0x41,0x3E},//@(32)
//{0x00,0x7E,0x11,0x11,0x11,0x7E},//A(33)
//{0x00,0x7F,0x49,0x49,0x49,0x3E},//B(34)
//{0x00,0x3E,0x41,0x41,0x41,0x22},//C(35)
//{0x00,0x7F,0x41,0x41,0x22,0x1C},//D(36)
//{0x00,0x7F,0x49,0x49,0x49,0x41},//E(37)
//{0x00,0x7F,0x09,0x09,0x09,0x01},//F(38)
//{0x00,0x3E,0x41,0x49,0x49,0x7A},//G(39)
//{0x00,0x7F,0x08,0x08,0x08,0x7F},//H(40)
//{0x00,0x00,0x41,0x7F,0x41,0x00},//I(41)
//{0x00,0x20,0x40,0x41,0x3F,0x01},//J(42)
//{0x00,0x7F,0x08,0x14,0x22,0x41},//K(43)
//{0x00,0x7F,0x40,0x40,0x40,0x40},//L(44)
//{0x00,0x7F,0x02,0x04,0x02,0x7F},//M(45)
//{0x00,0x7F,0x04,0x08,0x10,0x7F},//N(46)
//{0x00,0x3E,0x41,0x41,0x41,0x3E},//O(47)
//{0x00,0x7F,0x09,0x09,0x09,0x06},//P(48)
//{0x00,0x3E,0x41,0x51,0x21,0x5E},//Q(49)
//{0x00,0x7F,0x09,0x19,0x29,0x46},//R(50)
//{0x00,0x46,0x49,0x49,0x49,0x31},//S(51)
//{0x00,0x01,0x01,0x7F,0x01,0x01},//T(52)
//{0x00,0x3F,0x40,0x40,0x40,0x3F},//U(53)
//{0x00,0x1F,0x20,0x40,0x20,0x1F},//V(54)
//{0x00,0x3F,0x40,0x38,0x40,0x3F},//W(55)
//{0x00,0x63,0x14,0x08,0x14,0x63},//X(56)
//{0x00,0x03,0x04,0x78,0x04,0x03},//Y(57)
//{0x00,0x61,0x51,0x49,0x45,0x43},//Z(58)
//{0x00,0x00,0x7F,0x41,0x41,0x00},//[(59)
//{0x00,0x15,0x16,0x7C,0x16,0x15},//\(60)
//{0x00,0x00,0x41,0x41,0x7F,0x00},//](61)
//{0x00,0x04,0x02,0x01,0x02,0x04},//^(62)
//{0x00,0x40,0x40,0x40,0x40,0x40},//_(63)
//{0x00,0x00,0x01,0x02,0x04,0x00},//`(64)
//{0x00,0x20,0x54,0x54,0x54,0x78},//a(65)
//{0x00,0x7F,0x48,0x44,0x44,0x38},//b(66)
//{0x00,0x38,0x44,0x44,0x44,0x20},//c(67)
//{0x00,0x38,0x44,0x44,0x48,0x7F},//d(68)
//{0x00,0x38,0x54,0x54,0x54,0x18},//e(69)
//{0x00,0x08,0x7E,0x09,0x01,0x02},//f(70)
//{0x00,0x0C,0x52,0x52,0x52,0x3E},//g(71)
//{0x00,0x7F,0x08,0x04,0x04,0x78},//h(72)
//{0x00,0x00,0x44,0x7D,0x40,0x00},//i(73)
//{0x00,0x20,0x40,0x44,0x3D,0x00},//j(74)
//{0x00,0x7F,0x10,0x28,0x44,0x00},//k(75)
//{0x00,0x00,0x41,0x7F,0x40,0x00},//l(76)
//{0x00,0x7E,0x02,0x0C,0x02,0x7C},//m(77)
//{0x00,0x7E,0x04,0x02,0x02,0x7C},//n(78)
//{0x00,0x38,0x44,0x44,0x44,0x38},//o(79)
//{0x00,0x7C,0x14,0x14,0x14,0x08},//p(80)
//{0x00,0x08,0x14,0x14,0x18,0x7C},//q(81)
//{0x00,0x7C,0x08,0x04,0x04,0x08},//r(82)
//{0x00,0x48,0x54,0x54,0x54,0x20},//s(83)
//{0x00,0x04,0x3F,0x44,0x40,0x20},//t(84)
//{0x00,0x3C,0x40,0x40,0x20,0x7C},//u(85)
//{0x00,0x1C,0x20,0x40,0x20,0x1C},//v(86)
//{0x00,0x3C,0x40,0x30,0x40,0x3C},//w(87)
//{0x00,0x44,0x28,0x10,0x28,0x44},//x(88)
//{0x00,0x0C,0x50,0x50,0x50,0x3C},//y(89)
//{0x00,0x44,0x64,0x54,0x4C,0x44},//z(90)
//{0x00,0x00,0x08,0x36,0x41,0x00},//{(91)
//{0x00,0x00,0x00,0x7F,0x00,0x00},//|(92)
//{0x00,0x00,0x41,0x36,0x08,0x00},//}(93)
//{0x00,0x08,0x04,0x08,0x10,0x08},//~(94)
//{0x00,0x08,0x08,0x2A,0x1C,0x08},//→(127)
//{0x00,0x08,0x1C,0x2A,0x08,0x08},//←(128)
//{0x00,0x04,0x02,0x7F,0x02,0x04},//↑(129)
//{0x00,0x10,0x20,0x7F,0x20,0x10},//↓(130)
//{0x00,0x1C,0x2A,0x32,0x2A,0x1C},//笑面(131)
//{0x00,0x1C,0x22,0x44,0x22,0x1C}};//爱心(132)

/*--------------------------------------------------------------*/
//	  字体:	GulimChe12
//取码规则:	高位在前, 行列扫描, 阴码(1-亮, 0-灭)
//查表方法: 要显示的ASCII码-32就可以得到字库码的指针
unsigned char Font_code16[][16] = { { 0x00, 0x00, 0x00, 0x00, 0x00, 0x00, 0x00, 0x00, 0x00, 0x00, 0x00, 0x00, 0x00, 0x00, 0x00, 0x00 },	// (0)
{ 0x00, 0x00, 0x00, 0x04, 0x04, 0x00, 0x04, 0x04, 0x04, 0x04, 0x04, 0x04, 0x04, 0x00, 0x00, 0x00 },	//！
{ 0x00, 0x00, 0x00, 0x00, 0x00, 0x00, 0x00, 0x00, 0x00, 0x10, 0x70, 0x30, 0x30, 0x40, 0x00, 0x00 },	//“
{ 0x00, 0x00, 0x24, 0x24, 0x24, 0x7E, 0x24, 0x24, 0x24, 0x7E, 0x48, 0x48, 0x48, 0x00, 0x00, 0x00 },	//#
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{ 0x00, 0x00, 0x00, 0x00, 0x00, 0x00, 0x00, 0x00, 0x00, 0x00, 0x00, 0x00, 0x00, 0x20, 0x5A, 0x04 },	//~
};

unsigned char hanzi_Idx[] = { "：。前后左右档位无高低中副履带空复·小援一路火花闪电！开机" };
//unsigned char hanzi[] = {	                                             //wrong
////取码规则:	高位在前, 行扫描, 阴码(1-亮, 0-灭)
////查表方法: 要显示的ASCII码-32就可以得到字库码的指针 微软雅黑16*12
//0x00,0x08,0x08,0x10,0xFE,0x00,0x00,0xFE,0x02,0x02,0x1E,0x00,
//0x00,0x00,0x04,0x04,0x7F,0x00,0x00,0x3F,0x02,0x04,0x04,0x00,//北0,
//0x00,0x02,0x04,0xD8,0x52,0x43,0x7C,0x40,0xD0,0x0C,0x00,0x00,
//0x00,0x10,0x10,0x13,0x14,0x54,0x34,0x14,0x13,0x10,0x10,0x00,//京0
//0x00,0x02,0x04,0x18,0xE4,0x08,0x10,0xEE,0xC2,0x02,0x0E,0x00,
//0x00,0x00,0x04,0x04,0x27,0x58,0x04,0x07,0x34,0x07,0x08,0x00,//龙0,
//0x00,0x08,0xF8,0x08,0xF0,0x10,0x10,0xFE,0x08,0x88,0x78,0x00,
//0x00,0x00,0x3F,0x22,0x23,0x42,0x02,0x3F,0x20,0x2F,0x30,0x00,//邱0,
//0x00,0x00,0x00,0x00,0x00,0x78,0x1F,0x80,0x10,0x00,0x10,0x00,
//0x1F,0xF8,0x10,0x40,0x10,0x40,0x10,0x40,0x7F,0xFC,0x00,0x00,//丘4
//0x00,0x40,0x80,0x7E,0x52,0xD2,0x52,0xD2,0x7C,0x40,0x00,0x00,
//0x00,0x0C,0x74,0x27,0x1E,0x25,0x04,0x3F,0x21,0x21,0x3F,0x00,//智0,
//0x00,0xFE,0x90,0x90,0x92,0xFC,0x00,0x7E,0x22,0x42,0x06,0x00,
//0x00,0x0F,0x36,0x4A,0x0A,0x19,0x00,0x3E,0x09,0x11,0x0E,0x00,//能0,
//0x00,0x00,0x00,0x00,0x00,0x10,0x7D,0x90,0x10,0xD0,0x7F,0x10,
//0x19,0x90,0x37,0xFC,0x50,0x10,0x10,0x10,0x10,0x10,0x00,0x00,//科7
//0x00,0x00,0x00,0x00,0x20,0x40,0xFF,0xFC,0x20,0x40,0x27,0xF8,
//0x32,0x08,0xE1,0x10,0x20,0xE0,0x21,0xE0,0xEE,0x1C,0x00,0x00,//技8
//0x00,0x00,0x00,0x00,0x62,0x00,0x37,0xF8,0x6A,0x08,0x37,0xE8,
//0x0F,0xF8,0x24,0xA8,0x24,0xA8,0x47,0xE8,0x40,0x78,0x00,0x00,//淘9
//0x00,0x00,0x00,0x00,0x03,0x00,0x7F,0xF8,0x40,0x08,0x7F,0xF8,
//0x02,0x00,0x3F,0xF0,0x02,0x60,0x02,0x10,0x7F,0xF8,0x00,0x00,//宝10
//0x00,0x00,0x00,0x00,0x01,0x80,0x3F,0xF8,0x21,0x00,0x21,0xF8,
//0x21,0x00,0x2F,0xF0,0x28,0x10,0x68,0x10,0x4F,0xF0,0x00,0x00,//店11
//0x00,0x00,0x00,0x00,0x60,0xC0,0x3F,0xFC,0x62,0x40,0x34,0xF8,
//0x0D,0x48,0x36,0xB0,0x24,0x60,0x44,0xE0,0x47,0x1C,0x00,0x00,//液12
//0x00,0x00,0x00,0x00,0x3F,0xF0,0x20,0x10,0x3F,0xF0,0x3F,0xF0,
//0x7C,0xF8,0x44,0x88,0x7C,0xF8,0x44,0x88,0x7C,0xF8,0x44,0x88,//晶13
//0x00,0x00,0x10,0x20,0x08,0xC0,0x3F,0xF0,0x22,0x10,0x3F,0xF0,
//0x22,0x10,0x3F,0xF0,0x02,0x00,0x7F,0xF8,0x02,0x00,0x02,0x00,//单14
//0x00,0x00,0x00,0x00,0x10,0x40,0x10,0x40,0x10,0x40,0x1F,0xFC,
//0x10,0x00,0x1F,0xE0,0x10,0x20,0x20,0x20,0x60,0x20,0x00,0x00,//片15
//0x00,0x00,0x20,0x00,0x23,0xE0,0xFA,0x20,0x22,0x20,0x72,0x20,
//0x6A,0x20,0xA2,0x20,0xA2,0x24,0x24,0x24,0x28,0x38,0x00,0x00,//机16
//0x00,0x00,0x20,0x00,0x7E,0xF8,0x90,0x88,0xFE,0x88,0x38,0xF8,
//0xC6,0x00,0x3F,0xF0,0x3F,0xF0,0x20,0x10,0x3F,0xF0,0x00,0x00,//智17
//0x00,0x00,0x00,0x00,0x30,0x8C,0x46,0xF4,0xFF,0x84,0x7E,0xF8,
//0x42,0x84,0x7E,0x98,0x7E,0xE4,0x42,0x84,0x4E,0xFC,0x00,0x00,//能18
//0x00,0x00,0x04,0x00,0x08,0x00,0x7F,0xF8,0x11,0x00,0x31,0x00,
//0x3F,0xF0,0x01,0x00,0x01,0x00,0xFF,0xFC,0x01,0x00,0x01,0x00,//车19
//};
unsigned char hanzi16x16[] = {
//取码规则:	高位在前, 行扫描, 阴码(1-亮, 0-灭)
//查表方法: 要显示的ASCII码-32就可以得到字库码的指针 宋体16*16加粗

0x00, 0x00, 0x00, 0x00, 0x00, 0x1C, 0x00, 0x1C, 0x00, 0x00, 0x00, 0x1C, 0x00, 0x1C, 0x00, 0x00, 0x00, 0x00, 0x00, 0x00, 0x00, 0x00, 0x00, 0x00, 0x00, 0x00, 0x00, 0x00, 0x00, 0x00, 0x00, 0x00,	//：
0x00, 0x00, 0x00, 0x00, 0x00, 0x38, 0x00, 0x6C, 0x00, 0x6C, 0x00, 0x38, 0x00, 0x00, 0x00, 0x00, 0x00, 0x00, 0x00, 0x00, 0x00, 0x00, 0x00, 0x00, 0x00, 0x00, 0x00, 0x00, 0x00, 0x00, 0x00, 0x00,	//。
0x18, 0x6C, 0x3C, 0xFC, 0x30, 0xCC, 0x30, 0xCC, 0x36, 0xFC, 0x36, 0xCC, 0x36, 0xCC, 0x36, 0xFC, 0x36, 0xCC, 0x36, 0xCC, 0x30, 0xFC, 0x00, 0x00, 0xFF, 0xFF, 0x0C, 0x30, 0x18, 0x30, 0x18, 0x18,	//前
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0x00, 0x28, 0x70, 0x48, 0x48, 0x48, 0x48, 0x88, 0x48, 0x88, 0x08, 0x89, 0x08, 0xAA, 0x08, 0xAA, 0x08, 0x9C, 0x08, 0x8C, 0x08, 0x88, 0x08, 0xBF, 0x08, 0x88, 0x08, 0x88, 0x0F, 0x88, 0x00, 0x08	//机1
};

/*--------------------------------------------------------------*/
/*--------------------------------------------------------------*/
//液晶字符输出(6*8字体)
//x: 0 - 20	(行)
//y: 0 -19	(列)
//void LCD_P6X8(unsigned char x, unsigned char y, unsigned char c_dat,unsigned int word_color,unsigned int back_color)
//{
//	unsigned char i,j;
//	LCD_SetPos(x*6,y*8,(x+1)*6-1,(y+1)*8-1);   //定位字符显示区域
//	for(j=0; j<8; j++)
//	{
//		for(i=0; i<6; i++)
//		{
//			if((Font_code8[c_dat-32][i]) & (0x01<<j))
//				LCD_write_para16(word_color);
//			else
//				LCD_write_para16(back_color);
//		}
//	}
//}
/*--------------------------------------------------------------*/
//液晶字符输出(8*16字体)
//x: 0 -15   (行)
//y: 1-4  	 (列)
void LCD_P8X16(unsigned char x, unsigned char y, unsigned char c_dat, unsigned int word_color, unsigned int back_color)
{
	unsigned char i, j;

	LCD_SetPos(x * 8, y * 16, (x + 1) * 8 - 1, (y + 1) * 16 - 1);	//定位字符显示区域
	for (j = 0; j < 16; j++)
	{
		for (i = 0; i < 8; i++)
		{
			if ((Font_code16[c_dat - 32][j]) & (0x80 >> i))
				LCD_write_para16(word_color);
			else
				LCD_write_para16(back_color);
		}
	}
}

/*--------------------------------------------------------------*/
//液晶字符串输出(8*16字体)
//x: 0 - 15 (行)
//y: 1 - 4  (列)
void LCD_P8X16Str(unsigned char x, unsigned char y, unsigned char *s_dat, unsigned int word_color, unsigned int back_color)
{
	x = 15 - x;
	y = 4 - y;
	while (*s_dat)
	{
		LCD_P8X16(x--, y, *s_dat++, word_color, back_color);
		//        delay_ms(201);//汉字显示速度，演示用，平时可以注释掉，不影响显示速度
	}
}

//液晶字符输出(16*12字体)
//x: 0 - 7	(行)
//y: 0 -12	(列)
//void LCD_P16X12Str(unsigned char x,unsigned char y,unsigned char *s_dat,unsigned int word_color,unsigned int back_color)
//{
//	unsigned char wm=0,ii = 0,i,j;
//	unsigned int adder=1; 
//	
//	while(s_dat[ii] != '\0')
//	{
//	  	wm = 0;
//	  	adder = 1;
//	  	while(hanzi_Idx[wm] > 127)
//	  	{
//	  		if(hanzi_Idx[wm] == s_dat[ii])
//	  		{
//	  			if(hanzi_Idx[wm + 1] == s_dat[ii + 1])
//	  			{
//	  				adder = wm * 12;
//	  				break;
//	  			}
//	  		}
//	  		wm += 2;			
//	  	}		
//	  	if(adder != 1)// 显示汉字
//	  	{
//	  		LCD_SetPos(x*16,y*12,(x+1)*16-1,(y+1)*12-1);			//定位字符显示区域
//	  		for(j=0; j <24; j++)
//			{
//				for(i=0; i<8; i++)
//				{
//					if((hanzi[adder]) &  (0x80>>i))
//						LCD_write_para16(word_color);
//					else
//						LCD_write_para16(back_color);
//				}
//				adder += 1;		 	
//			} 					
//	  	}
//	  	else			  //显示空白字符
//	  	{}
//	    //y+=1;//左右方向
//		x+=1;//上下方向
//	  	ii += 2;
// //     HAL_Delay(201);//汉字显示速度，演示用，平时可以注释掉，不影响显示速度
//	}
//}
//液晶字符输出一行(16*16字体)
//x: 0 - 7	(初始列)
//y: 1 -4	(行)
void LCD_P16X16Str(unsigned char x, unsigned char y, unsigned char *s_dat, unsigned int word_color, unsigned int back_color)
{
	unsigned char wm = 0, ii = 0, i, j;
	unsigned int adder = 1;
	x = 7 - x;
	y = 4 - y;
	while (s_dat[ii] != '\0')
	{
		wm = 0;
		adder = 1;
		while (hanzi_Idx[wm] > XMAX - 1)
		{
			if (hanzi_Idx[wm] == s_dat[ii])
			{
				if (hanzi_Idx[wm + 1] == s_dat[ii + 1])
				{
					adder = wm * 16;
					break;
				}
			}
			wm += 2;
		}
		if (adder != 1)			// 显示汉字
		{
			LCD_SetPos(x * 16, y * 16, (x + 1) * 16 - 1, (y + 1) * 16 - 1);	//定位字符显示区域
			for (j = 0; j < 32; j++)
			{
				for (i = 0; i < 8; i++)
				{
					if ((hanzi16x16[adder]) & (0x80 >> i))
						LCD_write_para16(word_color);
					else
						LCD_write_para16(back_color);
				}
				adder += 1;
			}
		}
		else			  //显示空白字符
		{
		}
		//y+=1;//左右方向
		x -= 1;			  //上下方向
		ii += 2;
//     delay_ms(201);//汉字显示速度，演示用，平时可以注释掉，不影响显示速度
	}
}

/*--------------------------------------------------------------*/
//液晶字符串输出(6*8字体)
//x: 0 - 20 (行)
//y: 0 -19 (列)
//void LCD_P6X8Str(unsigned char x, unsigned char y, unsigned char *s_dat,unsigned int word_color,unsigned int back_color)
//{
//	while(*s_dat)
//        {
//          LCD_P6X8(x++, y, *s_dat++,word_color,back_color);
// //         delay_ms(201);//汉字显示速度，演示用，平时可以注释掉，不影响显示速度
//        }
//}
/*--------------------------------------------------------------*/
//定位输出数字
//x: 0 - 20  (行)
//y: 0 - 19 (列)
//num: 0 - 65535	要显示的数字
//num_bit: 0 - 5	数字的位数
//void LCD_P6X8NUM(unsigned char x, unsigned char y, unsigned int num, unsigned char num_bit,unsigned int word_color,unsigned int back_color)
//{
//	signed char i;
//	unsigned char ii;
//	unsigned char dat[6];
//	for(i = 0; i < 6; i++) dat[i] = 0; i = 0;	//初始化数据
//	while(num / 10)								//拆位
//	{
//		dat[i] = num % 10;						//最低位
//		num /= 10; i++;		
//	}
//	dat[i] = num;								//最高位
//	ii = i;										//保存dat的位数
//	for(; i>= 0; i--)	dat[i] += 48;			//转化成ASCII
//	for(i = 0; i < num_bit; i++)
//	LCD_P6X8(x, y + i, ' ',word_color,back_color);		//清显示区域
//	for(i = ii; i>= 0; i--)
//	LCD_P6X8(x++, y, dat[i],word_color,back_color);		//输出数值
//}
/*--------------------------------------------------------------*/

/*--------------------------------------------------------------*/
////液晶字符输出(8*8字体)
////x: 0 - 15	(行)
////y: 0 -19	(列)
//void LCD_P8X8(unsigned char x, unsigned char y, unsigned char c_dat,unsigned int word_color,unsigned int back_color)
//{
//	unsigned char i,j;
//	LCD_SetPos(x*8,y*8,(x+1)*8-1,(y+1)*8-1);			//定位字符显示区域
//	for(j=0; j<8; j++)
//	{
//		LCD_write_para16(back_color);
//		for(i=0; i<6; i++)
//		{
//			if((Font_code8[c_dat-32][i]) & (0x01<<j))
//				LCD_write_para16(word_color);
//			else
//				LCD_write_para16(back_color);
//		}
//		LCD_write_para16(back_color);
//	}
//}
/*--------------------------------------------------------------*/
////液晶字符串输出(8*8字体)
////x: 0 - 15 (行)
////y: 0 -19 (列)
//void LCD_P8X8Str(unsigned char x, unsigned char y, unsigned char *s_dat,unsigned int word_color,unsigned int back_color)
//{
//	while(*s_dat) 
//        {
//          LCD_P8X8(x++, y, *s_dat++,word_color,back_color);
//        }
//}
/*--------------------------------------------------------------*/
//定位输出数字
//x: 0 - 15  (行)
//y: 0 - 19 (列)
//num: 0 - 65535	要显示的数字
//num_bit: 0 - 5	数字的位数
//void LCD_P8X8NUM(unsigned char x, unsigned char y, unsigned int num, unsigned char num_bit,unsigned int word_color,unsigned int back_color)
//{
//	signed  char i;
//	unsigned char ii;
//	unsigned char dat[6];
//	for(i = 0; i < 6; i++) dat[i] = 0; i = 0;	//初始化数据
//	while(num / 10)								//拆位
//	{
//		dat[i] = num % 10;						//最低位
//		num /= 10; i++;		
//	}
//	dat[i] = num;								//最高位
//	ii = i;										//保存dat的位数
//	for(; i>= 0; i--)	dat[i] += 48;			//转化成ASCII
//	for(i = 0; i < num_bit; i++)
//	LCD_P8X8(x, y + i, ' ',word_color,back_color);					//清显示区域
//	for(i = ii; i>= 0; i--)
//	LCD_P8X8(x, y++, dat[i],word_color,back_color);					//输出数值
//}
